## configs/openbmc_systemd_defconfig
```kconfig
BR2_arm=y
BR2_TOOLCHAIN_BUILDROOT_GLIBC=y
BR2_TARGET_GENERIC_HOSTNAME="opembmc"
BR2_TARGET_GENERIC_ISSUE="Welcome to opembmc"
BR2_INIT_SYSTEMD=y
BR2_TARGET_GENERIC_GETTY_BAUDRATE_38400=y
BR2_SYSTEM_DHCP="eth0"
BR2_LINUX_KERNEL=y
BR2_LINUX_KERNEL_CUSTOM_GIT=y
BR2_LINUX_KERNEL_CUSTOM_REPO_URL="https://github.com/openbmc/linux.git"
BR2_LINUX_KERNEL_CUSTOM_REPO_VERSION="dev"
BR2_LINUX_KERNEL_DEFCONFIG="aspeed"
BR2_LINUX_KERNEL_APPENDED_UIMAGE=y
BR2_LINUX_KERNEL_UIMAGE_LOADADDR="0x40001000"
BR2_LINUX_KERNEL_INTREE_DTS_NAME="aspeed-bmc-opp-palmetto"
BR2_PACKAGE_GETTEXT=y
BR2_PACKAGE_DBUS_PYTHON=y
BR2_PACKAGE_PYTHON=y
BR2_PACKAGE_PYTHON_GOBJECT=y
BR2_PACKAGE_OPENSSL=y
BR2_PACKAGE_DROPBEAR=y
BR2_PACKAGE_IPTABLES=y
BR2_PACKAGE_NETCAT=y
BR2_PACKAGE_RSYNC=y
BR2_PACKAGE_TCPDUMP=y
BR2_PACKAGE_PFLASH=y
BR2_PACKAGE_SYSTEMD_ALL_EXTRAS=y
BR2_TARGET_ROOTFS_CPIO=y
BR2_TARGET_ROOTFS_CPIO_XZ=y
BR2_TARGET_ROOTFS_CPIO_UIMAGE=y
# BR2_TARGET_ROOTFS_TAR is not set
```

## package/btbridged/Config.in
```kconfig
config BR2_PACKAGE_BTBRIDGED
	bool "btbridged"
	depends on BR2_PACKAGE_SYSTEMD
	help
	  BT Interface bridge for IPMI messages
```

## package/pflash/Config.in
```kconfig
config BR2_PACKAGE_PFLASH
	bool "pflash"
	depends on BR2_PACKAGE_SYSTEMD
	help
	  Open-Power pflash tool
```
